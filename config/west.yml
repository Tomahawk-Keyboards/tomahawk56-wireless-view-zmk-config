## config/west.yml
```yaml
manifest:
  remotes:
    - name: zmkfirmware
      url-base: https://github.com/MityaLiu
  projects:
    - name: zmk
      remote: zmkfirmware
      revision: add_tomahawk56_shield_2
      import: app/west.yml
  self:
    path: config
```
